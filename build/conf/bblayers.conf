## build/conf/bblayers.conf
```bitbake
# POKY_BBLAYERS_CONF_VERSION is increased each time build/conf/bblayers.conf
# changes incompatibly
POKY_BBLAYERS_CONF_VERSION = "2"

BBPATH = "${TOPDIR}"
BBFILES ?= ""

BBLAYERS ?= " \
  /home/eric/code/clickityos/poky/meta \
  /home/eric/code/clickityos/poky/meta-poky \
  /home/eric/code/clickityos/poky/meta-yocto-bsp \
  /home/eric/code/clickityos/meta-raspberrypi \
  /home/eric/code/clickityos/meta-openembedded/meta-networking \
  /home/eric/code/clickityos/meta-openembedded/meta-oe \
  /home/eric/code/clickityos/meta-openembedded/meta-python \
  /home/eric/code/clickityos/meta-openembedded/meta-multimedia \
  /home/eric/code/clickityos/meta-browser \
  /home/eric/code/clickityos/meta-clang \
  /home/eric/code/clickityos/meta-python2 \
  /home/eric/code/clickityos/meta-clickity \
  /home/eric/code/clickityos/meta-openauto \
  "
```

## poky-build-conf/conf/bblayers.conf
```bitbake
# POKY_BBLAYERS_CONF_VERSION is increased each time build/conf/bblayers.conf
# changes incompatibly
POKY_BBLAYERS_CONF_VERSION = "2"

BBPATH = "${TOPDIR}"
BBFILES ?= ""

BBLAYERS ?= " \
  /home/eric/code/clickityos/poky/meta \
  /home/eric/code/clickityos/poky/meta-poky \
  /home/eric/code/clickityos/poky/meta-yocto-bsp \
  "
```
